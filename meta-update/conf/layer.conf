## meta-update/conf/layer.conf
```bitbake
# We have a conf and classes directory, add to BBPATH
BBPATH .= ":${LAYERDIR}"

# We have recipes-* directories, add to BBFILES
BBFILES += "${LAYERDIR}/recipes-*/*/*.bb \
            ${LAYERDIR}/recipes-*/*/*.bbappend"

BBFILE_COLLECTIONS += "meta-update"
BBFILE_PATTERN_meta-mylayer = "^${LAYERDIR}/"
BBFILE_PRIORITY_meta-mylayer = "15"

LAYERDEPENDS_meta-mylayer = "core raspberrypi"
LAYERSERIES_COMPAT_meta-mylayer = "dunfell"
```

## meta-update/conf/machine/raspberrypi4.conf
```bitbake
#@TYPE: Machine
#@NAME: RaspberryPi 4 Development Board (32bit)
#@DESCRIPTION: Machine configuration for the RaspberryPi 4 in 32 bit mode

DEFAULTTUNE ?= "cortexa7thf-neon-vfpv4"
require conf/machine/include/tune-cortexa7.inc
include conf/machine/include/rpi-base.inc

MACHINE_FEATURES += "pci"
MACHINE_EXTRA_RRECOMMENDS += "\
    linux-firmware-rpidistro-bcm43455 \
    bluez-firmware-rpidistro-bcm4345c0-hcd \
"

# 'l' stands for LPAE
SDIMG_KERNELIMAGE ?= "kernel7l.img"
UBOOT_MACHINE = "rpi_4_32b_config"
SERIAL_CONSOLES ?= "115200;ttyS0"

VC4DTBO ?= "vc4-fkms-v3d"
ARMSTUB ?= "armstub7.bin"

#IMAGE_BOOT_FILES = "${BOOTFILES_DIR_NAME}/* \
# ${@make_dtb_boot_files(d)} \
# ${@bb.utils.contains('RPI_USE_U_BOOT', '1', \
#'u-boot.bin; boot.scr', \
#'${KERNEL_IMAGETYPE};${SDIMG_KERNELIMAGE}', d)} \"

IMAGE_BOOT_FILES_remove = "${KERNEL_IMAGETYPE}"
WKS_FILE = "sdimage-raspberrypi-dualrootfs.wks"
```

## meta-update/wic/sdimage-raspberrypi-dualrootfs.wks
```
kann# short-description: Create Raspberry Pi SD card image
# long-description: Creates a partitioned SD card image for use with
# Raspberry Pi. Boot files are located in the first vfat partition.

part /boot --source bootimg-partition --ondisk mmcblk0 --fstype=vfat --label boot --active --align 4096 --size 20
part / --source rootfs --ondisk mmcblk0 --fstype=ext4 --label root --align 4096
part /recovery --source rootfs --ondisk mmcblk0 --fstype=ext4 --label recovery --align 4096
part /data --ondisk mmcblk0 --fstype=ext4 --label data --align 4096 --size 600
```
